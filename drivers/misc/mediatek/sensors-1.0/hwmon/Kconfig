## drivers/misc/mediatek/sensors-1.0/hwmon/Kconfig
```kconfig
config MTK_HWMON
	bool "MTK HWMON Config"
	help
	  CONFIG_MTK_HWMON for sensor common util

config MTK_SENSOR_EVENT_6WORDS
	bool "Sensor misc events carry 6 data words"
	depends on MTK_HWMON
	help
	  Older vendor sensor HALs (e.g. Redmi 10 / selene) read struct
	  sensor_event from /dev/m_*_misc with 6 data words (36 bytes).
	  This kernel defaults to 8 words (44 bytes); with an older HAL every
	  event after the first is misparsed and no sensor data reaches
	  Android clients.
```

## drivers/misc/mediatek/sensors-1.0/sensorHub/Kconfig
```kconfig
config CUSTOM_KERNEL_SENSORHUB
	bool "CUSTOM KERNEL SENSORHUB support"
	help
	  Kernel space sensor hub driver.
	  Define project used all sensor hub
	  sensors. The value is combination of sensor hub driver(get data...etc)
	  and sensor hub framework driver(transmit shf info)

#source "drivers/misc/mediatek/sensors-1.0/sensorHub/SCP_sensorHub/Kconfig"
#source "drivers/misc/mediatek/sensors-1.0/sensorHub/SCP_sensorHub_v1/Kconfig"
#source "drivers/misc/mediatek/sensors-1.0/sensorHub/SCP_shf/Kconfig"

source "drivers/misc/mediatek/sensors-1.0/sensorHub/nanohub/Kconfig"

config MTK_SENSORHUB_NO_AP_TS_SEC
	bool "SCP firmware without ap_ts_sec in SET_CONFIG requests"
	depends on CUSTOM_KERNEL_SENSORHUB
	help
	  Older SCP sensor hub firmware (e.g. Redmi 10 / selene) expects
	  SCP_SENSOR_HUB_SET_CONFIG_REQ without the trailing ap_ts_sec field.
	  The request length is part of the IPI message, so a mismatch makes
	  the firmware reject the sensor FIFO setup and no data is delivered.
```
